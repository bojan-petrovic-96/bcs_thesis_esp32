## components/mqtt_config/Kconfig.projbuild
```kconfig
# put here your custom config value
menu "MQTT Config"
    config MQTT_URL
        string "Enter URL"
        default ""
    config MQTT_PORT
        int "Enter PORT"
        default 1883
    config MQTT_UNAME
        string "Enter USERNAME:"
        default ""
     config MQTT_PASSWORD
        string "Enter PASSWORD:"
        default ""
endmenu
```

## components/wifi_config/Kconfig.projbuild
```kconfig
# put here your custom config value
menu "WiFi Config"
    config WIFI_SSID
        string "Enter SSID:"
        default ""
    config WIFI_PASSWORD
        string "Enter password:"
        default ""
endmenu
```

## main/Kconfig.projbuild
```kconfig
# put here your custom config value
menu "Guest Room Config"
config ROOM_NUMBER
    string "Enter room number:"
    default "308"
config ROOM_GUEST
    string "Enter guest name:"
    default "name"
endmenu
```
